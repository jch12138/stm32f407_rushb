## board/Kconfig
```kconfig
menu "Hardware Drivers Config"

config SOC_STM32F407ZE
    bool
    select SOC_SERIES_STM32F4
    select RT_USING_COMPONENTS_INIT
    select RT_USING_USER_MAIN
    default y

menu "Onboard Peripheral Drivers"

endmenu

menu "On-chip Peripheral Drivers"

    config BSP_USING_GPIO
        bool "Enable GPIO"
        select RT_USING_PIN
        default y

    menuconfig BSP_USING_UART
        bool "Enable UART"
        default y
        select RT_USING_SERIAL
        if BSP_USING_UART
            config BSP_USING_UART4
                bool "Enable UART4"
                default y

            config BSP_UART4_RX_USING_DMA
                bool "Enable UART4 RX DMA"
                depends on BSP_USING_UART4 && RT_SERIAL_USING_DMA
                default n
        endif

    menuconfig BSP_USING_ADC
        bool "Enable ADC"
        default n
        select RT_USING_ADC
        if BSP_USING_ADC
            config BSP_USING_ADC1
                bool "Enable ADC1"
                default n
            
            config BSP_USING_ADC2
                bool "Enable ADC2"
                default n

            config BSP_USING_ADC3
                bool "Enable ADC3"
                default n
        endif
    
    menuconfig BSP_USING_PWM
        bool "Enable PWM"
        default n
        select RT_USING_PWM
        if BSP_USING_PWM
        menuconfig BSP_USING_PWM1
            bool "Enable timer1 output pwm"
            default n
            if BSP_USING_PWM1
                config BSP_USING_PWM1_CH1
                    bool "Enable PWM1 channel1"
                    default n
         
                config BSP_USING_PWM1_CH2
                    bool "Enable PWM1 channel2"
                    default n

                config BSP_USING_PWM1_CH3
                    bool "Enable PWM1 channel1"
                    default n

                config BSP_USING_PWM1_CH4
                    bool "Enable PWM1 channel1"
                    default n
            endif
        
        menuconfig BSP_USING_PWM2
            bool "Enable timer2 output pwm"
            default n
            if BSP_USING_PWM2
                config BSP_USING_PWM2_CH1
                    bool "Enable PWM2 channel1"
                    default n
         
                config BSP_USING_PWM2_CH2
                    bool "Enable PWM2 channel2"
                    default n

                config BSP_USING_PWM2_CH3
                    bool "Enable PWM2 channel1"
                    default n

                config BSP_USING_PWM2_CH4
                    bool "Enable PWM2 channel1"
                    default n
            endif
        endif
            
    source "../libraries/HAL_Drivers/Kconfig"    
    
endmenu

menu "Bsp Drivers"
    menuconfig RT_USING_BSPDRIVER
        bool "Enable Bsp Driver"
        default n
        if RT_USING_BSPDRIVER
            config RT_USING_GRAY
                bool "Enable gray scale sensor"
                default n
            
            config RT_USING_MOTOR
                bool "Enable motor"
                default n

            config RT_USING_OLED
                bool "Enable oled(spi)"
                default n
            
        endif

endmenu


endmenu
```
